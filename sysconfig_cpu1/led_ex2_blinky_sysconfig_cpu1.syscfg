/**
 * These arguments were used when this file was generated. They will be automatically applied on subsequent loads
 * via the GUI or CLI. Run CLI with '--help' for additional information on how to override these arguments.
 * @cliArgs --device "F2838x" --part "F2838x_176pin" --package "176pin" --context "CPU1" --product "C2000WARE@6.00.01.00"
 * @v2CliArgs --device "TMS320F28384D" --package "176pin" --context "CPU1" --product "C2000WARE@6.00.01.00"
 * @versions {"tool":"1.27.1+4634"}
 */

/**
 * Import only shared device/IPC ownership here. GPIO0/GPIO1 are intentionally
 * not owned by this SysConfig file on the power-control branch; the M1 power
 * BSP configures them as EPWM1A/EPWM1B after an OST-safe state is established.
 */
const device_support = scripting.addModule("/driverlib/device_support.js");
const ipc   = scripting.addModule("/driverlib/ipc.js");

/**
 * Write custom configuration values to the imported modules.
 */
ipc.ipcRegisterFlag = ["IPC_FLAG31"];
ipc.flagHandler31   = "IPC_SYNC";

system.clockTree.EPWMCLKDIV.divideValue = 1;
